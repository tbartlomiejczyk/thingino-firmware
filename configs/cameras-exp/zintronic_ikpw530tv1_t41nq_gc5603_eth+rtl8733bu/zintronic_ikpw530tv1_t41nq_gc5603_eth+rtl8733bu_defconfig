## configs/cameras-exp/zintronic_ikpw530tv1_t41nq_gc5603_eth+rtl8733bu/zintronic_ikpw530tv1_t41nq_gc5603_eth+rtl8733bu_defconfig
```kconfig
# NAME: Zintronic IKPW530TV1 (T41NQ, GC5603, ETH, RTL8733BU)
# FRAG: soc-xburst2 core
BR2_ETHERNET=y
BR2_INGENIC_SOC_MODEL="t41nq"
BR2_PACKAGE_THINGINO_UBOOT_FLASH_CONTROLLER_JZ_SFC=n
BR2_PACKAGE_THINGINO_UBOOT_FLASH_CONTROLLER_SFC0_NOR=y
BR2_PACKAGE_WIFI=y
BR2_PACKAGE_WIFI_RTL8733BU=y
BR2_SENSOR_1_NAME="gc5603"
BR2_THINGINO_AUDIO=y
BR2_THINGINO_NMEM_MB=0
BR2_THINGINO_RMEM_MB=64
BR2_THINGINO_SDCARD=y
BR2_PACKAGE_THINGINO_MOTORS=y
FLASH_SIZE_MB=16
BR2_LINUX_KERNEL_CONFIG_FRAGMENT_FILES="$(BR2_EXTERNAL_THINGINO_PATH)/configs/cameras-exp/zintronic_ikpw530tv1_t41nq_gc5603_eth+rtl8733bu/zintronic.kernel.config"
BR2_PACKAGE_THINGINO_KOPT_DWC2=y
BR2_PACKAGE_THINGINO_KOPT_DWC2_WIFI_ONLY=y
BR2_PACKAGE_THINGINO_RAPTOR_CONF_SENSOR_RST_GPIO="18"
BR2_PACKAGE_THINGINO_RAPTOR_CONF_IRCUT_ENABLED=y
BR2_PACKAGE_THINGINO_RAPTOR_CONF_IRCUT_GPIO_IRCUT="49"
BR2_PACKAGE_THINGINO_RAPTOR_CONF_IRCUT_GPIO_IRCUT2="50"
```
